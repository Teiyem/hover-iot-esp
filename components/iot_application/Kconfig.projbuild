## components/iot_application/Kconfig.projbuild
```kconfig
menu "Hover Application"

    config IOT_HOVER_MQTT_ENABLED
        bool "Enable Mqtt Component"
        default y
        select MQTT_PROTOCOL_311
        help
            Enable mqtt support.

    if IOT_HOVER_MQTT_ENABLED

    config MQTT_PROTOCOL_311
        bool "Overrides enabling the esp-idf mqtt component"
        default y
        help
           Don't set this to false if hover mqtt is enabled.
    endif

    if !IOT_HOVER_MQTT_ENABLED

    config MQTT_PROTOCOL_311
        bool "Overrides disabling the esp-idf mqtt component"
        default n
        help
           Don't set this to true if hover the mqtt is disabled.
    endif

    choice IOT_HOVER_SERVER_OPTION
        prompt "Environment options"
        default IOT_HOVER_SERVER_HTTP
        help
            The current running environment of the project

        config IOT_HOVER_SERVER_HTTP
           bool "Use the http server"
           help
              If selected the device will run a http server.

        config IOT_HOVER_SERVER_HTTPS
           bool "Use the https server"
           help
               If selected the device will run a https server.

    endchoice

    choice IOT_HOVER_ENV_OPTION
        prompt "Environment options"
        default IOT_HOVER_ENV_DEV
        help
            The current running environment of the project

        config IOT_HOVER_ENV_DEV
           bool "Dev environment"
           help
              Currently running in a dev environment

        config IOT_HOVER_ENV_PROD
           bool "Production environment"
           help
               Currently running in a production environment

    endchoice
endmenu
```

## examples/simple/sdkconfig.defaults
```kconfig
#
# Hover Application
#
CONFIG_IOT_HOVER_MQTT_ENABLED=y
CONFIG_MQTT_PROTOCOL_311=y
CONFIG_IOT_HOVER_ENV_DEV=y

#
# Partition
#
CONFIG_ESPTOOLPY_FLASHSIZE_4MB=y
CONFIG_PARTITION_TABLE_CUSTOM=y
CONFIG_PARTITION_TABLE_CUSTOM_FILENAME="partitions.csv"
CONFIG_PARTITION_TABLE_FILENAME="partitions.csv"
CONFIG_PARTITION_TABLE_OFFSET=0x10000
CONFIG_PARTITION_TABLE_MD5=y

# OTA
CONFIG_ESP_HTTPS_OTA_ALLOW_HTTP=y

# Application Rollback
CONFIG_BOOTLOADER_APP_ROLLBACK_ENABLE=y

# Protocomm
# CONFIG_ESP_PROTOCOMM_SUPPORT_SECURITY_VERSION_0 is not set
CONFIG_ESP_PROTOCOMM_SUPPORT_SECURITY_VERSION_1=y
CONFIG_ESP_PROTOCOMM_SUPPORT_SECURITY_VERSION_2=y

# Logging
CONFIG_LOG_MAXIMUM_LEVEL=4
CONFIG_LOG_DEFAULT_LEVEL=4

CONFIG_ESPTOOLPY_FLASHSIZE_4MB=y

#
# ESP System Settings
#
CONFIG_ESP_DEFAULT_CPU_FREQ_MHZ_240=y
CONFIG_ESP_DEFAULT_CPU_FREQ_MHZ=240
CONFIG_ESP32_DEFAULT_CPU_FREQ_240=y
CONFIG_ESP32_DEFAULT_CPU_FREQ_MHZ=240
```
